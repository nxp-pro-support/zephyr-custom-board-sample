## boards/nxp/rt_super/Kconfig.defconfig
```kconfig
# MIMXRT685-EVK board

# Copyright 2020, 2024 NXP
# SPDX-License-Identifier: Apache-2.0

if BOARD_RT_SUPER_MIMXRT685S_CM33

config NXP_IMXRT_BOOT_HEADER
	default y if !BOOTLOADER_MCUBOOT

config XTAL_SYS_CLK_HZ
	default 24000000

config SYSOSC_SETTLING_US
	default 260

config FLASH_SIZE
	default 8192

config FXOS8700_DRDY_INT1
	default y
	depends on FXOS8700_TRIGGER

endif # BOARD_MIMXRT685_EVK_MIMXRT685S_CM33
```

## boards/nxp/rt_super/Kconfig.rt_super
```kconfig
# Copyright 2020, 2024 NXP
# SPDX-License-Identifier: Apache-2.0

config BOARD_RT_SUPER
	select SOC_PART_NUMBER_MIMXRT685SFVKB
	select SOC_MIMXRT685S_CM33 if BOARD_RT_SUPER_MIMXRT685S_CM33
```

## boards/nxp/rt_super/board.yml
```yaml
board:
  name: rt_super
  full_name: rt_super
  vendor: nxp
  socs:
    - name: mimxrt685s
```
